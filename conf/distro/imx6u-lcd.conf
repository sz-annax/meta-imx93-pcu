## conf/distro/imx6u-lcd.conf
```bitbake
require conf/distro/imx93-pcu.conf

DISTRO = "imx6u-lcd"
DISTRO_NAME = "ANNAX i.MX6DualLite LCD Distro"
LICENSE_FLAGS_ACCEPTED += "commercial"

PACKAGECONFIG:remove:pn-weston = "imxg2d"
PACKAGECONFIG:append:pn-weston = " egl opengl"
DEFAULTBACKEND:pn-weston-init = "fbdev"
PACKAGECONFIG:remove:pn-weston-init = "use-g2d use-pixman"

BBMASK += " \
    /meta-imx93-pcu/recipes-core/base-files/ \
    /meta-imx93-pcu/recipes-gopoint/ \
    /meta-imx93-pcu/recipes-multimedia/(chromium|onnxruntime)/ \
"
```

## conf/distro/imx93-pcu.conf
```bitbake
require conf/distro/poky.conf

DISTRO = "imx-nxp"
DISTRO_NAME = "ANNAX i.MX93 Distro"
DISTRO_VERSION = "1.0.0"
DISTROOVERRIDES = "fsl"

MAINTAINER = "bruce <zhengjing.zhu@wabtec.com>"

GOVERSION ?= "1.24%"

# Bootstrap Go using a binary release from golang.org.  If you want to bootstrap
# from source using the C-implemented Go 1.4 (only supports x86-64 hosts) then use
# go-native.
PREFERRED_PROVIDER_go-native ?= "go-binary-native"
PREFERRED_VERSION_virtual/${TARGET_PREFIX}go ?= "${GOVERSION}"
PREFERRED_VERSION_go-cross-${TUNE_PKGARCH} ?= "${GOVERSION}"
PREFERRED_VERSION_go-crosssdk-${SDK_ARCH} ?= "${GOVERSION}"
PREFERRED_VERSION_go-cross-canadian-${TRANSLATED_TARGET_ARCH} ?= "${GOVERSION}"
PREFERRED_VERSION_go ?= "${GOVERSION}"
PREFERRED_VERSION_go-native ?= "${GOVERSION}"
PREFERRED_VERSION_go-runtime ?= "${GOVERSION}"
PREFERRED_VERSION_nativesdk-go ?= "${GOVERSION}"
PREFERRED_VERSION_nativesdk-go-runtime ?= "${GOVERSION}"

POKY_DEFAULT_DISTRO_FEATURES:remove = "${POKY_DEFAULT_DISTRO_FEATURES_IMX_REMOVE}"
POKY_DEFAULT_DISTRO_FEATURES_IMX_REMOVE             ?= "wayland"
POKY_DEFAULT_DISTRO_FEATURES_IMX_REMOVE:mx6-nxp-bsp ?= "wayland vulkan"
POKY_DEFAULT_DISTRO_FEATURES_IMX_REMOVE:mx7-nxp-bsp ?= "wayland vulkan"
DISTRO_FEATURES:remove = "pulseaudio"

POKY_DEFAULT_DISTRO_FEATURES:append = " ${POKY_DEFAULT_DISTRO_FEATURES_IMX_APPEND}"
POKY_DEFAULT_DISTRO_FEATURES_IMX_APPEND             ?= ""
POKY_DEFAULT_DISTRO_FEATURES_IMX_APPEND:mx6-nxp-bsp ?= ""
POKY_DEFAULT_DISTRO_FEATURES_IMX_APPEND:mx7-nxp-bsp ?= ""

DISTRO_FEATURES:append:mx8-nxp-bsp = " virtualization"
SKIP_META_VIRT_SANITY_CHECK = "1"

SKIP_META_SECURITY_SANITY_CHECK = "1"
SKIP_META_TPM_SANITY_CHECK = "1"

# Set a more generic tuning for code reuse across parts
DEFAULTTUNE:mx8-nxp-bsp    ?= "armv8a-crc-crypto"
DEFAULTTUNE:mx8m-nxp-bsp   ?= "armv8a-crc-crypto"
DEFAULTTUNE:mx8qm-nxp-bsp  ?= "armv8a-crc-crypto"
DEFAULTTUNE:mx8x-nxp-bsp   ?= "armv8a-crc-crypto"
DEFAULTTUNE:mx8ulp-nxp-bsp ?= "armv8a-crc-crypto"
DEFAULTTUNE:mx9-nxp-bsp    ?= "armv8a-crc-crypto"
DEFAULTTUNE:mx91-nxp-bsp  ?= "armv8a-crc-crypto"
DEFAULTTUNE:mx93-nxp-bsp   ?= "armv8a-crc-crypto"

# Use systemd as default init manager
POKY_INIT_MANAGER = "systemd"

# Use virtual-runc as a default container runtime
# runtime: runc, crun, runv, runx
VIRTUAL-RUNTIME_container_runtime = "virtual-runc"

PACKAGECONFIG:append:pn-gstreamer1.0-plugins-ugly = " x264"

PACKAGECONFIG:append:pn-perf = " jevents"

PACKAGECONFIG:append:pn-pulseaudio = " autospawn-for-root"

PACKAGECONFIG:append:class-target:pn-qtquick3d = " examples"
PACKAGECONFIG:remove:class-target:pn-qtquick3d = "openxr"

PACKAGECONFIG:append:class-target:pn-qtwebengine = " examples"

PACKAGECONFIG:append:pn-systemd = " unmanaged-network"

PACKAGECONFIG:append:mx93-nxp-bsp:pn-qtbase = " gles2"
PACKAGECONFIG:remove:mx93-nxp-bsp:pn-qtbase = "no-opengl linuxfb"

DISTRO = "imx93-pcu"

# Remove conflicting backends
DISTRO_FEATURES:remove = "directfb x11 "
DISTRO_FEATURES:append = " wayland pam systemd"
```

## conf/machine/imx6u-lcd.conf
```bitbake
#@TYPE: Machine
#@NAME: LCD Display Platform (IM356-M-A)
#@SOC: i.MX6DL
#@DESCRIPTION: MCIMX6U6AVM08AC, 1 GiB DDR3, USDHC4 eMMC and USDHC2 microSD

MACHINEOVERRIDES =. "mx6:mx6dl:"

require conf/machine/include/imx-base.inc
require conf/machine/include/arm/armv7a/tune-cortexa9.inc

IMX_DEFAULT_BSP = "nxp"
PREFERRED_PROVIDER_virtual/kernel = "linux-imx"
PREFERRED_PROVIDER_virtual/bootloader = "u-boot-imx"

KERNEL_DEVICETREE = "nxp/imx/imx6dl-imx6u-lcd.dtb"
SERIAL_CONSOLES = "115200;ttymxc0"

UBOOT_CONFIG ??= "sd"
UBOOT_CONFIG[sd] = "imx6u_lcd_defconfig,sdcard"
```

## conf/machine/imx91-pcu-ip.conf
```bitbake
#@TYPE: Machine
#@NAME: NXP i.MX 91 PCU IP with phyCORE LPDDR4
#@SOC: i.MX91
#@DESCRIPTION: Machine configuration for NXP i.MX 91 11x11 phyCORE with 1GB LPDDR4
#@MAINTAINER: Jun Zhu <junzhu@nxp.com>

MACHINEOVERRIDES =. "mx91:"

require conf/machine/include/imx-base.inc
require conf/machine/include/arm/armv8-2a/tune-cortexa55.inc

MACHINE_FEATURES += "pci"
MACHINE_FEATURES:append:use-nxp-bsp = " optee"

# imx91-pcu-audio.dtb
KERNEL_DEVICETREE = " \
    freescale/imx91-pcu-ip-phytec.dtb \
"

UBOOT_DTB_NAME = "imx91-pcu-ip-phytec.dtb"

# IMX_DEFAULT_BOOTLOADER = "u-boot-imx-pcu"
PREFERRED_PROVIDER_virtual/kernel     = "linux-imx-pcu"
PREFERRED_PROVIDER_virtual/bootloader = "u-boot-imx-pcu"

LOADADDR = ""
UBOOT_SUFFIX = "bin"
UBOOT_MAKE_TARGET = ""

SPL_BINARY = "spl/u-boot-spl.bin"

UBOOT_CONFIG ??= "sd"
UBOOT_CONFIG[sd]   = "${UBOOT_CONFIG_BASENAME}_defconfig,sdcard"

# Set ATF platform name
ATF_PLATFORM = "imx91"

IMXBOOT_TARGETS = "flash_singleboot"

IMX_BOOT_SOC_TARGET = "iMX91"
IMX_BOOT_SEEK = "32"

# We have to disable SERIAL_CONSOLE due to auto-serial-console
SERIAL_CONSOLES = "115200;ttyLP0"

IMX_DEFAULT_BSP = "nxp"

UBOOT_CONFIG_BASENAME = "imx91-phycore"

DDR_FIRMWARE_NAME = " \
    lpddr4_dmem_1d_v202201.bin \
    lpddr4_dmem_2d_v202201.bin \
    lpddr4_imem_1d_v202201.bin \
    lpddr4_imem_2d_v202201.bin \
"
```

## conf/machine/imx93-pcu-ip.conf
```bitbake
#@TYPE: Machine
#@NAME: NXP i.MX 93 PCU IP with phyCORE LPDDR4
#@SOC: i.MX93
#@DESCRIPTION: Machine configuration for NXP i.MX 93 11x11 phyCORE with 1GB LPDDR4
#@MAINTAINER: Jun Zhu <junzhu@nxp.com>

MACHINEOVERRIDES =. "mx93:"

require conf/machine/include/imx-base.inc
require conf/machine/include/arm/armv8-2a/tune-cortexa55.inc

MACHINE_FEATURES += "pci"
MACHINE_FEATURES:append:use-nxp-bsp = " optee"

# imx93-pcu-audio.dtb
KERNEL_DEVICETREE = " \
    freescale/imx93-pcu-audio.dtb \
    freescale/imx93-pcu-ip.dtb \
    freescale/imx93-pcu-recovery.dtb \
    freescale/imx93-pcu-ip-phytec.dtb \
"

UBOOT_DTB_NAME = "imx93-pcu-audio.dtb"

# IMX_DEFAULT_BOOTLOADER = "u-boot-imx-pcu"
PREFERRED_PROVIDER_virtual/kernel     = "linux-imx-pcu"
PREFERRED_PROVIDER_virtual/bootloader = "u-boot-imx-pcu"

LOADADDR = ""
UBOOT_SUFFIX = "bin"
UBOOT_MAKE_TARGET = ""

SPL_BINARY = "spl/u-boot-spl.bin"

UBOOT_CONFIG ??= "sd"
UBOOT_CONFIG[sd]   = "${UBOOT_CONFIG_BASENAME}_defconfig,sdcard"

# Set ATF platform name
ATF_PLATFORM = "imx93"

IMXBOOT_TARGETS = "flash_singleboot"

IMX_BOOT_SOC_TARGET = "iMX9"
IMX_BOOT_SEEK = "32"

# We have to disable SERIAL_CONSOLE due to auto-serial-console
SERIAL_CONSOLES = "115200;ttyLP0"

IMX_DEFAULT_BSP = "nxp"

UBOOT_CONFIG_BASENAME = "imx93_11x11_phycore"

DDR_FIRMWARE_NAME = " \
    lpddr4_dmem_1d_v202201.bin \
    lpddr4_dmem_2d_v202201.bin \
    lpddr4_imem_1d_v202201.bin \
    lpddr4_imem_2d_v202201.bin \
"
```

## conf/machine/imx93-pcu.conf
```bitbake
#@TYPE: Machine
#@NAME: NXP i.MX 93 PCU with LPDDR4X
#@SOC: i.MX93
#@DESCRIPTION: Machine configuration for NXP i.MX 93 11x11 EVK with LPDDR4X
#@MAINTAINER: Jun Zhu <junzhu@nxp.com>

MACHINEOVERRIDES =. "mx93:"

require conf/machine/include/imx-base.inc
require conf/machine/include/arm/armv8-2a/tune-cortexa55.inc

MACHINE_FEATURES += "pci"
MACHINE_FEATURES:append:use-nxp-bsp = " optee"

# imx93-pcu-audio.dtb
KERNEL_DEVICETREE = " \
    freescale/imx93-pcu-audio.dtb \
    freescale/imx93-pcu-ip.dtb \
    freescale/imx93-pcu-recovery.dtb \
    freescale/imx93-pcu-demo.dtb \
    freescale/imx93-acp.dtb \
    freescale/imx93-acc.dtb \
    freescale/imx93-ledf.dtb \
"

UBOOT_DTB_NAME = "imx93-pcu-audio.dtb"

# IMX_DEFAULT_BOOTLOADER = "u-boot-imx-pcu"
PREFERRED_PROVIDER_virtual/kernel     = "linux-imx-pcu"
PREFERRED_PROVIDER_virtual/bootloader = "u-boot-imx-pcu"

LOADADDR = ""
UBOOT_SUFFIX = "bin"
UBOOT_MAKE_TARGET = ""

SPL_BINARY = "spl/u-boot-spl.bin"

UBOOT_CONFIG ??= "sd"
UBOOT_CONFIG[sd]   = "${UBOOT_CONFIG_BASENAME}_defconfig,sdcard"
UBOOT_CONFIG[ecc]  = "${UBOOT_CONFIG_BASENAME}_inline_ecc_defconfig"
UBOOT_CONFIG[ld]   = "${UBOOT_CONFIG_BASENAME}_ld_defconfig"

# Set ATF platform name
ATF_PLATFORM = "imx93"

IMXBOOT_TARGETS = "flash_singleboot"

IMX_BOOT_SOC_TARGET = "iMX9"
IMX_BOOT_SEEK = "32"

# We have to disable SERIAL_CONSOLE due to auto-serial-console
SERIAL_CONSOLES = "115200;ttyLP0"

IMX_DEFAULT_BSP = "nxp"

UBOOT_CONFIG_BASENAME = "imx93_11x11_evk"

DDR_FIRMWARE_NAME = " \
    lpddr4_dmem_1d_v202201.bin \
    lpddr4_dmem_2d_v202201.bin \
    lpddr4_imem_1d_v202201.bin \
    lpddr4_imem_2d_v202201.bin \
"
```

## recipes-lcd/files/imx6u_lcd_defconfig
```kconfig
CONFIG_ARM=y
CONFIG_ARCH_MX6=y
CONFIG_MX6DL=y
CONFIG_TARGET_MX6DLSABRESD=y
CONFIG_SYS_MALLOC_LEN=0x1000000
CONFIG_NR_DRAM_BANKS=1
CONFIG_ENV_SIZE=0x2000
CONFIG_ENV_IS_NOWHERE=y
CONFIG_IMX_CONFIG="board/freescale/mx6sabresd/mx6dlsabresd.cfg"
CONFIG_DEFAULT_DEVICE_TREE="imx6dl-imx6u-lcd"
CONFIG_BOOTDELAY=3
CONFIG_USE_BOOTCOMMAND=y
CONFIG_BOOTCOMMAND="for mmcdev in 1 3; do if mmc dev ${mmcdev} 0 && mmc rescan; then if load mmc ${mmcdev}:1 ${loadaddr} zImage && load mmc ${mmcdev}:1 ${fdt_addr_r} imx6dl-imx6u-lcd.dtb && part uuid mmc ${mmcdev}:2 rootuuid; then setenv bootargs console=ttymxc0,115200 earlycon root=PARTUUID=${rootuuid} rootwait rw; bootz ${loadaddr} - ${fdt_addr_r}; fi; fi; done"
CONFIG_HUSH_PARSER=y
CONFIG_SYS_MAXARGS=32
CONFIG_SYS_PBSIZE=532
CONFIG_BOUNCE_BUFFER=y
CONFIG_CMD_BOOTZ=y
CONFIG_CMD_MEMTEST=y
CONFIG_CMD_MMC=y
CONFIG_CMD_PART=y
CONFIG_CMD_GPIO=y
CONFIG_CMD_EXT4=y
CONFIG_CMD_FAT=y
CONFIG_CMD_FS_GENERIC=y
CONFIG_CMD_CACHE=y
CONFIG_CMD_CRC32=y
CONFIG_CRC32_VERIFY=y
CONFIG_SUPPORT_EMMC_BOOT=y
CONFIG_OF_CONTROL=y
CONFIG_DM_GPIO=y
CONFIG_DM_MMC=y
CONFIG_FSL_USDHC=y
CONFIG_DM_SERIAL=y
CONFIG_MXC_UART=y
CONFIG_PINCTRL=y
CONFIG_PINCTRL_IMX6=y
CONFIG_DM_REGULATOR=y
CONFIG_DM_REGULATOR_FIXED=y
CONFIG_IMX_THERMAL=y
CONFIG_SYS_RELOC_GD_ENV_ADDR=y
CONFIG_USB=y
CONFIG_USB_GADGET=y
CONFIG_USB_GADGET_MANUFACTURER="FSL"
CONFIG_USB_GADGET_VENDOR_NUM=0x1fc9
CONFIG_USB_GADGET_PRODUCT_NUM=0x0152
CONFIG_CI_UDC=y
CONFIG_USB_FUNCTION_FASTBOOT=y
CONFIG_FASTBOOT_UUU_SUPPORT=y
CONFIG_FASTBOOT_FLASH=y
CONFIG_FASTBOOT_BUF_ADDR=0x20000000
CONFIG_FASTBOOT_BUF_SIZE=0x10000000
# CONFIG_ENV_IS_IN_MMC is not set
# CONFIG_LDO_BYPASS_CHECK is not set
# CONFIG_VIDEO is not set
# CONFIG_PCI is not set
# CONFIG_SPI is not set
# CONFIG_NET is not set
# CONFIG_DM_PMIC is not set
# CONFIG_EFI_LOADER is not set
```
